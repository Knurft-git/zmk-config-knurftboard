## config/boards/shields/Kconfig.defconfig
```kconfig
if SHIELD_KNURFTBOARD_LEFT

config ZMK_KEYBOARD_NAME
    default "Knurftboard"

config ZMK_SPLIT_ROLE_CENTRAL
    default y

endif

if SHIELD_KNURFTBOARD_LEFT || SHIELD_KNURFTBOARD_RIGHT

config ZMK_SPLIT
    default y

endif
```

## config/boards/shields/Kconfig.shield
```kconfig
config SHIELD_KNUFTBOARD_LEFT
    def_bool $(shields_list_contains,knurftboard_left)

config SHIELD_KNUFTBOARD_RIGHT
    def_bool $(shields_list_contains,knurftboard_right)
```
